#include <dt-bindings/led/led.h>

/ {
    chosen {
        zmk,underglow = &underglow;
    };
};

&spi1 {
    compatible = "nordic,nrf-spi";
    status = "okay";

    mosi-pin = <6>;   // 🔥 THIS IS THE IMPORTANT PIN
    sck-pin = <5>;
    miso-pin = <7>;

    underglow: ws2812@0 {
        compatible = "worldsemi,ws2812-spi";
        label = "WS2812";

        reg = <0>;
        spi-max-frequency = <4000000>;

        chain-length = <4>;   // ✅ YOUR BOARD (4 LEDs)

        spi-one-frame = <0x70>;
        spi-zero-frame = <0x40>;

        color-mapping = <LED_COLOR_ID_GREEN
                         LED_COLOR_ID_RED
                         LED_COLOR_ID_BLUE>;
    };
};
